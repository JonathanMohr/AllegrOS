ENTRY(_start)
OUTPUT_FORMAT("elf32-i386")
addr = 0x00010000;

SECTIONS
{
    . = addr;
    
    .text               : { __text_start = .;       *(.text)    }
    .data               : { __data_start = .;       *(.data)    }
    .rodata             : { __rodata_start = .;     *(.rodata)  }
    .bss                : { __bss_start = .;        *(.bss)     }
    
    __end = .;
}
